## buildroot/package/brcm-ams-tracing/Config.in
```kconfig
config BR2_PACKAGE_BRCM_AMS_TRACING
       bool "brcm_ams_tracing"

       help
	 brcm_ams_trace tool reads raw binary tracelog buffer generated by AMS
	 at user defined physical memory address, decodes and generates an output
	 in human readable form.

	 brcm_ams_trace tool reads user set values in debugfs for physical
	 address, buffer size of the tacelog buffer, validates and prints log to
	 console or can redirect it to an output file. The tool can also capture raw
	 binary data to an output file be decoded on host machine.

	 This feature is available in broadcom stb kernel version >= 4.9-1.21,
	 5.4-1.1 and 5.10.

	 Say Y, if you are using Broadcom hardware.
```
